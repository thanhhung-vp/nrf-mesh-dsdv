## CMakeLists.txt
```
#
# Copyright (c) 2020 Nordic Semiconductor ASA
#
# SPDX-License-Identifier: LicenseRef-Nordic-5-Clause
#
cmake_minimum_required(VERSION 3.20.0)

find_package(Zephyr REQUIRED HINTS $ENV{ZEPHYR_BASE})
project(chat_2)

# NORDIC SDK APP START
target_sources(app PRIVATE
    src/main.c
    src/chat_cli.c
    src/model_handler.c
    src/neighbor_mgr.c   # NEW
    src/dsdv_router.c    # NEW
)
target_include_directories(app PRIVATE include)
# NORDIC SDK APP END
```

## prj.conf
```kconfig
#
# Copyright (c) 2020 Nordic Semiconductor ASA
#
# SPDX-License-Identifier: LicenseRef-Nordic-5-Clause
#
CONFIG_NCS_SAMPLES_DEFAULTS=y

# Deferred logging helps improve LPN power consumption
# when friendship is established.
CONFIG_LOG_MODE_DEFERRED=y

# General configuration
CONFIG_NCS_APPLICATION_BOOT_BANNER_STRING="DSDV ROUTING NODE"
CONFIG_SYSTEM_WORKQUEUE_STACK_SIZE=2048
CONFIG_FLASH=y
CONFIG_FLASH_MAP=y
CONFIG_NVS=y
CONFIG_SETTINGS=y
CONFIG_NVS_LOOKUP_CACHE=y
CONFIG_SETTINGS_NVS_NAME_CACHE=y
CONFIG_HWINFO=y
CONFIG_DK_LIBRARY=y
CONFIG_PM_PARTITION_SIZE_SETTINGS_STORAGE=0x8000

# Bluetooth configuration
CONFIG_BT=y
CONFIG_BT_DEVICE_NAME="DSDV ROUTING NODE"
CONFIG_BT_L2CAP_TX_BUF_COUNT=12
CONFIG_BT_OBSERVER=y
CONFIG_BT_PERIPHERAL=y
CONFIG_BT_SETTINGS=y

# Disable unused Bluetooth features
CONFIG_BT_CTLR_LE_ENC=n
CONFIG_BT_PHY_UPDATE=n
CONFIG_BT_CTLR_CHAN_SEL_2=n
CONFIG_BT_CTLR_MIN_USED_CHAN=n
CONFIG_BT_CTLR_PRIVACY=n

# Bluetooth Mesh configuration
CONFIG_BT_MESH=y
CONFIG_BT_MESH_RELAY=n
CONFIG_BT_MESH_FRIEND=y
CONFIG_BT_MESH_RX_SEG_MAX=20
CONFIG_BT_MESH_TX_SEG_MAX=20
CONFIG_BT_MESH_SEG_BUFS=20
CONFIG_BT_MESH_TX_SEG_MSG_COUNT=6
CONFIG_BT_MESH_RX_SEG_MSG_COUNT=6
CONFIG_BT_MESH_MSG_CACHE_SIZE=40
CONFIG_BT_MESH_ADV_BUF_COUNT=12
CONFIG_BT_MESH_PB_GATT=y
CONFIG_BT_MESH_GATT_PROXY=y
CONFIG_BT_MESH_DK_PROV=y

CONFIG_BT_MESH_LOG_LEVEL_WRN=n
CONFIG_BT_MESH_LOG_LEVEL_ERR=y
CONFIG_BT_MESH_LOG_LEVEL_INF=n
CONFIG_BT_MESH_LOG_LEVEL_DBG=n
# Enable Shell module and use UART as a backend
CONFIG_SHELL=y
CONFIG_SHELL_BACKEND_SERIAL=y
CONFIG_FLASH_SHELL=n
CONFIG_LOG_BACKEND_RTT=n
CONFIG_BT_CTLR_TX_PWR_MINUS_40=y

# ADC configuration for battery voltage measurement
CONFIG_ADC=y
CONFIG_ADC_NRFX_SAADC=y
```

## src/main.c
```c
/* main.c */
#include <zephyr/kernel.h>
#include <zephyr/bluetooth/bluetooth.h>
#include <bluetooth/mesh/dk_prov.h>
#include <dk_buttons_and_leds.h>
#include "model_handler.h"

static void bt_ready(int err)
{
    if (err) {
        printk("Bluetooth init failed (err %d)\n", err);
        return;
    }

    printk("Bluetooth initialized\n");
    dk_leds_init();

    /* Initialize Mesh with our Custom Composition */
    err = bt_mesh_init(bt_mesh_dk_prov_init(), model_handler_init());
    if (err) {
        printk("Mesh init failed (err %d)\n", err);
        return;
    }

    if (IS_ENABLED(CONFIG_SETTINGS)) {
        settings_load();
    }

    bt_mesh_prov_enable(BT_MESH_PROV_ADV | BT_MESH_PROV_GATT);
    printk("DSDV Mesh Node Started\n");
}

int main(void)
{
    int err = bt_enable(bt_ready);
    if (err) {
        printk("Bluetooth init failed (err %d)\n", err);
    }
    return 0;
}
```

## include/chat_cli.h
```c
#ifndef CHAT_CLI_H
#define CHAT_CLI_H

#include <zephyr/bluetooth/mesh.h>
#include "dsdv_types.h"

#ifdef __cplusplus
extern "C" {
#endif

/* OpCodes */
#define BT_MESH_CHAT_CLI_OP_DSDV_HELLO    BT_MESH_MODEL_OP_2(0x00, 0x01)
#define BT_MESH_CHAT_CLI_OP_DSDV_UPDATE   BT_MESH_MODEL_OP_2(0x00, 0x02)
#define BT_MESH_CHAT_CLI_OP_DSDV_DATA     BT_MESH_MODEL_OP_2(0x00, 0x03)

struct bt_mesh_chat_cli {
    const struct bt_mesh_model *model;
    struct bt_mesh_model_pub pub;
    struct net_buf_simple pub_msg;
    uint8_t buf[BT_MESH_MODEL_BUF_LEN(BT_MESH_CHAT_CLI_OP_DSDV_DATA, 20)];
};

/* API for App Layer */
int bt_mesh_chat_cli_data_send(struct bt_mesh_chat_cli *chat, uint16_t data);

/* Model Definitions */
extern const struct bt_mesh_model_cb _bt_mesh_chat_cli_cb;
extern const struct bt_mesh_model_op _bt_mesh_chat_cli_op[];

#ifdef __cplusplus
}
#endif
#endif
```

## include/dsdv_router.h
```c
#ifndef DSDV_ROUTER_H
#define DSDV_ROUTER_H

#include "dsdv_types.h"
#include <stdbool.h>

/* Export global variables solely for Shell Commands visibility */
extern struct dsdv_route_entry g_dsdv_routes[DSDV_ROUTE_TABLE_SIZE];
extern uint8_t g_dsdv_my_gradient;

/* Core API */
void dsdv_router_init(bool is_sink_node);
void dsdv_router_update(uint16_t dest, uint16_t next_hop, uint8_t hop_count, 
                       uint32_t seq_num, uint8_t is_sink);
struct dsdv_route_entry* dsdv_router_find(uint16_t dest);
void dsdv_router_cleanup(void); // Remove stale routes
void dsdv_router_recalc_gradient(bool is_sink_node);

/* Helper API */
bool dsdv_router_is_duplicate(uint16_t src, uint32_t seq);
uint32_t dsdv_router_get_seq(void);
void dsdv_router_inc_seq(void);

#endif
```

## include/dsdv_types.h
```c
/* dsdv_types.h */
#ifndef DSDV_TYPES_H
#define DSDV_TYPES_H

#include <zephyr/types.h>
#include <zephyr/toolchain.h>

/* Configuration Constants */
#define DSDV_ROUTE_TABLE_SIZE      32
#define MAX_NEIGHBORS              16
#define MAX_UPDATE_ENTRIES         10  /* Số lượng route tối đa trong 1 gói Update */
#define DUP_CACHE_SIZE             16

/* Timeouts */
#define HELLO_INTERVAL_MS          2000
#define UPDATE_INTERVAL_MS         10000
#define DSDV_NEIGHBOR_TIMEOUT_MS   15000 /* 3x Hello interval + buffer */
#define DSDV_ROUTE_TIMEOUT_MS      45000 

/* Addressing */
#define SINK_NODE_ADDR             0x0001
#define BROADCAST_ADDR             0xFFFF

/* --- Network Packet Structures (Over-the-air) --- */

/* HELLO Packet */
struct dsdv_hello {
    uint16_t src;
    uint32_t seq_num;
    uint8_t is_sink;
    uint8_t gradient;
} __packed;

/* UPDATE Packet Headers */
struct dsdv_update_header {
    uint16_t src;
    uint8_t num_entries;
} __packed;

struct dsdv_update_entry {
    uint16_t dest;
    uint8_t hop_count;
    uint32_t seq_num;
    uint8_t is_sink;
} __packed;

/* DATA Packet */
struct dsdv_data_packet {
    uint16_t src;
    uint16_t dest;
    uint32_t seq_num;
    uint8_t hop_count;
    uint16_t payload;
} __packed;

/* --- Internal Structures --- */

/* Routing Table Entry */
struct dsdv_route_entry {
    uint16_t dest;             /* Destination Address */
    uint16_t next_hop;         /* Next Hop Address */
    uint8_t hop_count;         /* Metric */
    uint32_t seq_num;          /* Destination Sequence Number */
    uint32_t last_update_time; /* Timestamp for timeout */
    uint8_t changed:1;         /* Flag: Need to send in next update? */
    uint8_t is_sink:1;         /* Flag: Is destination a sink? */
};

#endif /* DSDV_TYPES_H */
```

## include/model_handler.h
```c
#ifndef MODEL_HANDLER_H
#define MODEL_HANDLER_H

#include <zephyr/bluetooth/mesh.h>

#ifdef __cplusplus
extern "C" {
#endif

const struct bt_mesh_comp *model_handler_init(void);
void mesh_led_blink(int count);

#ifdef __cplusplus
}
#endif
#endif
```

## include/neighbor_mgr.h
```c
#ifndef NEIGHBOR_MGR_H
#define NEIGHBOR_MGR_H

#include "dsdv_types.h"
#include <stdbool.h>

void neighbor_mgr_init(void);
void neighbor_mgr_update(uint16_t addr, int8_t rssi);
bool neighbor_mgr_is_valid(uint16_t addr);
int neighbor_mgr_get_all(uint16_t *addrs, int8_t *rssi, int max_count);

#endif
```

## src/chat_cli.c
```c
/* src/chat_cli.c */
#include "chat_cli.h"
#include "dsdv_router.h"
#include "neighbor_mgr.h"
#include "model_handler.h" 
#include <zephyr/logging/log.h>
#include <zephyr/random/random.h>
#include <zephyr/bluetooth/mesh/access.h>

LOG_MODULE_REGISTER(chat_cli, CONFIG_LOG_DEFAULT_LEVEL);

static struct bt_mesh_chat_cli *g_chat;
static struct k_work_delayable dsdv_hello_work;
static struct k_work_delayable dsdv_update_work;

/* Sink Node Check */
#ifdef CONFIG_BT_MESH_DSDV_SINK_NODE
    #define IS_SINK_NODE true
#else
    #define IS_SINK_NODE false
#endif

/* --- Handlers --- */

static int handle_dsdv_hello(const struct bt_mesh_model *model,
                             struct bt_mesh_msg_ctx *ctx,
                             struct net_buf_simple *buf)
{
    struct dsdv_hello hello;
    memcpy(&hello, net_buf_simple_pull_mem(buf, sizeof(hello)), sizeof(hello));

    // 1. Update Neighbor
    neighbor_mgr_update(ctx->addr, ctx->recv_rssi);

    // 2. Update Route to Sender (Direct connection -> hop 1)
    dsdv_router_update(ctx->addr, ctx->addr, 1, hello.seq_num, hello.is_sink);

    // 3. If sender has route to sink, update gradient info
    if (hello.gradient != 255) {
        dsdv_router_update(SINK_NODE_ADDR, ctx->addr, hello.gradient + 1, 
                           hello.seq_num, hello.is_sink);
    }

    dsdv_router_recalc_gradient(IS_SINK_NODE);
    return 0;
}

static int handle_dsdv_update(const struct bt_mesh_model *model,
                              struct bt_mesh_msg_ctx *ctx,
                              struct net_buf_simple *buf)
{
    struct dsdv_update_header hdr;
    memcpy(&hdr, net_buf_simple_pull_mem(buf, sizeof(hdr)), sizeof(hdr));

    neighbor_mgr_update(ctx->addr, ctx->recv_rssi);

    for (int i = 0; i < hdr.num_entries; i++) {
        struct dsdv_update_entry entry;
        memcpy(&entry, net_buf_simple_pull_mem(buf, sizeof(entry)), sizeof(entry));

        // Add 1 hop to the metric received
        uint8_t new_hops = (entry.hop_count == 255) ? 255 : entry.hop_count + 1;
        
        dsdv_router_update(entry.dest, ctx->addr, new_hops, entry.seq_num, entry.is_sink);
    }
    
    dsdv_router_recalc_gradient(IS_SINK_NODE);
    return 0;
}

static int handle_dsdv_data(const struct bt_mesh_model *model,
                            struct bt_mesh_msg_ctx *ctx,
                            struct net_buf_simple *buf)
{
    struct dsdv_data_packet pkt;
    memcpy(&pkt, net_buf_simple_pull_mem(buf, sizeof(pkt)), sizeof(pkt));

    if (dsdv_router_is_duplicate(pkt.src, pkt.seq_num)) {
        return 0;
    }

    /* FIX: Use bt_mesh_primary_addr() instead of elem->addr */
    uint16_t my_addr = bt_mesh_primary_addr();
    
    LOG_INF("DATA: Src 0x%04x Dest 0x%04x Payload %d (Hops: %d)", 
            pkt.src, pkt.dest, pkt.payload, pkt.hop_count);

    if (pkt.dest == my_addr) {
        LOG_INF(">>> DATA REACHED DESTINATION! <<<");
        mesh_led_blink(2); 
        return 0;
    }

    // Forwarding
    struct dsdv_route_entry *route = dsdv_router_find(pkt.dest);
    if (route && route->hop_count < 255) {
        pkt.hop_count++;
        
        struct bt_mesh_msg_ctx new_ctx = {
            .app_idx = ctx->app_idx,
            .addr = route->next_hop, // Unicast to next hop
            .send_ttl = BT_MESH_TTL_DEFAULT,
        };
        
        BT_MESH_MODEL_BUF_DEFINE(msg, BT_MESH_CHAT_CLI_OP_DSDV_DATA, sizeof(pkt));
        bt_mesh_model_msg_init(&msg, BT_MESH_CHAT_CLI_OP_DSDV_DATA);
        
        /* FIX: Pass address of msg (&msg) */
        net_buf_simple_add_mem(&msg, &pkt, sizeof(pkt));

        /* FIX: Pass address of msg (&msg) */
        if (bt_mesh_model_send(model, &new_ctx, &msg, NULL, NULL) == 0) {
            LOG_INF("Forwarded to 0x%04x", route->next_hop);
        }
    } else {
        LOG_WRN("No route to 0x%04x, drop.", pkt.dest);
    }

    return 0;
}

const struct bt_mesh_model_op _bt_mesh_chat_cli_op[] = {
    { BT_MESH_CHAT_CLI_OP_DSDV_HELLO,  0, handle_dsdv_hello },
    { BT_MESH_CHAT_CLI_OP_DSDV_UPDATE, 0, handle_dsdv_update },
    { BT_MESH_CHAT_CLI_OP_DSDV_DATA,   0, handle_dsdv_data },
    BT_MESH_MODEL_OP_END,
};

/* --- Workers --- */

static void dsdv_hello_worker(struct k_work *work)
{
    if (!g_chat) return;

    /* FIX: Use bt_mesh_primary_addr() */
    struct dsdv_hello hello_pkt = {
        .src = bt_mesh_primary_addr(),
        .seq_num = dsdv_router_get_seq(),
        .is_sink = IS_SINK_NODE,
        .gradient = g_dsdv_my_gradient
    };
    
    dsdv_router_inc_seq();

    BT_MESH_MODEL_BUF_DEFINE(msg, BT_MESH_CHAT_CLI_OP_DSDV_HELLO, sizeof(hello_pkt));
    bt_mesh_model_msg_init(&msg, BT_MESH_CHAT_CLI_OP_DSDV_HELLO);
    
    /* FIX: Pass address of msg (&msg) */
    net_buf_simple_add_mem(&msg, &hello_pkt, sizeof(hello_pkt));

    // Broadcast Hello
    struct bt_mesh_msg_ctx ctx = {
        .app_idx = 0, 
        .addr = BROADCAST_ADDR,
        .send_ttl = 1, // Hello only goes to neighbors
    };

    /* FIX: Pass address of msg (&msg) */
    bt_mesh_model_send(g_chat->model, &ctx, &msg, NULL, NULL);

    k_work_reschedule(&dsdv_hello_work, K_MSEC(HELLO_INTERVAL_MS));
}

static void dsdv_update_worker(struct k_work *work)
{
    if (!g_chat) return;

    dsdv_router_cleanup(); // Clean old routes first

    // Create Update Packet
    BT_MESH_MODEL_BUF_DEFINE(msg, BT_MESH_CHAT_CLI_OP_DSDV_UPDATE, 64); // Approx size
    bt_mesh_model_msg_init(&msg, BT_MESH_CHAT_CLI_OP_DSDV_UPDATE);
    
    // Placeholder for Header
    /* FIX: Pass address of msg (&msg) */
    struct dsdv_update_header *hdr = net_buf_simple_add(&msg, sizeof(struct dsdv_update_header));
    
    /* FIX: Use bt_mesh_primary_addr() */
    hdr->src = bt_mesh_primary_addr();
    hdr->num_entries = 0;

    int entries = 0;
    for (int i = 0; i < DSDV_ROUTE_TABLE_SIZE; i++) {
        if (g_dsdv_routes[i].dest != 0 && g_dsdv_routes[i].changed) {
            
            /* FIX: Pass address of msg (&msg) */
            struct dsdv_update_entry *entry = net_buf_simple_add(&msg, sizeof(struct dsdv_update_entry));
            entry->dest = g_dsdv_routes[i].dest;
            entry->hop_count = g_dsdv_routes[i].hop_count;
            entry->seq_num = g_dsdv_routes[i].seq_num;
            entry->is_sink = g_dsdv_routes[i].is_sink;
            
            g_dsdv_routes[i].changed = 0; // Clear flag
            entries++;
            
            if (entries >= MAX_UPDATE_ENTRIES) break;
        }
    }
    hdr->num_entries = entries;

    if (entries > 0) {
        struct bt_mesh_msg_ctx ctx = {
            .app_idx = 0,
            .addr = BROADCAST_ADDR,
            .send_ttl = 1,
        };
        /* FIX: Pass address of msg (&msg) */
        bt_mesh_model_send(g_chat->model, &ctx, &msg, NULL, NULL);
    }

    k_work_reschedule(&dsdv_update_work, K_MSEC(UPDATE_INTERVAL_MS));
}

/* --- Public Functions --- */

int bt_mesh_chat_cli_data_send(struct bt_mesh_chat_cli *chat, uint16_t data_payload)
{
    struct dsdv_route_entry *r = dsdv_router_find(SINK_NODE_ADDR);
    
    if (!r || r->hop_count == 255) {
        LOG_ERR("No route to sink!");
        return -EHOSTUNREACH;
    }

    struct dsdv_data_packet pkt = {
        /* FIX: Use bt_mesh_primary_addr() */
        .src = bt_mesh_primary_addr(),
        .dest = SINK_NODE_ADDR,
        .seq_num = sys_rand32_get(), // Unique ID for packet
        .hop_count = 0,
        .payload = data_payload
    };

    BT_MESH_MODEL_BUF_DEFINE(msg, BT_MESH_CHAT_CLI_OP_DSDV_DATA, sizeof(pkt));
    bt_mesh_model_msg_init(&msg, BT_MESH_CHAT_CLI_OP_DSDV_DATA);
    
    /* FIX: Pass address of msg (&msg) */
    net_buf_simple_add_mem(&msg, &pkt, sizeof(pkt));

    struct bt_mesh_msg_ctx ctx = {
        .app_idx = 0,
        .addr = r->next_hop,
        .send_ttl = BT_MESH_TTL_DEFAULT,
    };

    /* FIX: Pass address of msg (&msg) */
    return bt_mesh_model_send(chat->model, &ctx, &msg, NULL, NULL);
}

static int bt_mesh_chat_cli_init(const struct bt_mesh_model *model)
{
    struct bt_mesh_chat_cli *chat = model->rt->user_data;
    chat->model = model;
    g_chat = chat;

    neighbor_mgr_init();
    dsdv_router_init(IS_SINK_NODE);

    k_work_init_delayable(&dsdv_hello_work, dsdv_hello_worker);
    k_work_init_delayable(&dsdv_update_work, dsdv_update_worker);

    return 0;
}

static int bt_mesh_chat_cli_start(const struct bt_mesh_model *model)
{
    k_work_schedule(&dsdv_hello_work, K_MSEC(1000));
    k_work_schedule(&dsdv_update_work, K_MSEC(5000));
    return 0;
}

const struct bt_mesh_model_cb _bt_mesh_chat_cli_cb = {
    .init = bt_mesh_chat_cli_init,
    .start = bt_mesh_chat_cli_start,
};
```

## src/dsdv_router.c
```c
#include "dsdv_router.h"
#include "neighbor_mgr.h"
#include <zephyr/kernel.h>
#include <string.h>
#include <zephyr/logging/log.h>

LOG_MODULE_REGISTER(dsdv_core, CONFIG_LOG_DEFAULT_LEVEL);

/* Globals */
struct dsdv_route_entry g_dsdv_routes[DSDV_ROUTE_TABLE_SIZE];
uint8_t g_dsdv_my_gradient = 255;

/* Locals */
static uint32_t g_my_seq_num = 0;
static struct { uint16_t src; uint32_t seq; } g_dup_cache[DUP_CACHE_SIZE];
static int g_dup_idx = 0;

void dsdv_router_init(bool is_sink_node)
{
    memset(g_dsdv_routes, 0, sizeof(g_dsdv_routes));
    memset(g_dup_cache, 0, sizeof(g_dup_cache));
    g_dsdv_my_gradient = is_sink_node ? 0 : 255;
    g_my_seq_num = 1;
}

struct dsdv_route_entry* dsdv_router_find(uint16_t dest)
{
    for (int i = 0; i < DSDV_ROUTE_TABLE_SIZE; i++) {
        if (g_dsdv_routes[i].dest == dest) {
            return &g_dsdv_routes[i];
        }
    }
    return NULL;
}

/* Core DSDV Algorithm Logic */
void dsdv_router_update(uint16_t dest, uint16_t next_hop, uint8_t hop_count, 
                        uint32_t seq_num, uint8_t is_sink)
{
    struct dsdv_route_entry *r = dsdv_router_find(dest);
    uint32_t now = k_uptime_get_32();

    if (r) {
        // Rule 1: Higher sequence number -> Always update
        bool update = (seq_num > r->seq_num);
        
        // Rule 2: Same sequence number but better hop count
        if (!update && (seq_num == r->seq_num) && (hop_count < r->hop_count)) {
            update = true;
        }

        if (update) {
            r->next_hop = next_hop;
            r->hop_count = hop_count;
            r->seq_num = seq_num;
            r->last_update_time = now;
            r->is_sink = is_sink;
            r->changed = 1; 
            // LOG_DBG("Route Updated: Dest 0x%04x via 0x%04x hops %d", dest, next_hop, hop_count);
        }
    } else {
        // Add new route
        for (int i = 0; i < DSDV_ROUTE_TABLE_SIZE; i++) {
            if (g_dsdv_routes[i].dest == 0) {
                g_dsdv_routes[i].dest = dest;
                g_dsdv_routes[i].next_hop = next_hop;
                g_dsdv_routes[i].hop_count = hop_count;
                g_dsdv_routes[i].seq_num = seq_num;
                g_dsdv_routes[i].last_update_time = now;
                g_dsdv_routes[i].is_sink = is_sink;
                g_dsdv_routes[i].changed = 1;
                // LOG_INF("New Route: Dest 0x%04x via 0x%04x", dest, next_hop);
                break;
            }
        }
    }
}

void dsdv_router_cleanup(void)
{
    uint32_t now = k_uptime_get_32();
    for (int i = 0; i < DSDV_ROUTE_TABLE_SIZE; i++) {
        if (g_dsdv_routes[i].dest != 0) {
            if ((now - g_dsdv_routes[i].last_update_time) > DSDV_ROUTE_TIMEOUT_MS) {
                // LOG_INF("Route Timeout: 0x%04x", g_dsdv_routes[i].dest);
                g_dsdv_routes[i].dest = 0; // Clear
                g_dsdv_routes[i].hop_count = 255;
            }
        }
    }
}

void dsdv_router_recalc_gradient(bool is_sink_node)
{
    if (is_sink_node) {
        g_dsdv_my_gradient = 0;
        return;
    }

    uint8_t min_hops = 255;
    
    // Find route to SINK (0x0001) or nodes marked as sink
    struct dsdv_route_entry *r = dsdv_router_find(SINK_NODE_ADDR);
    
    // Check if route exists AND next hop is a valid neighbor
    if (r && neighbor_mgr_is_valid(r->next_hop)) {
        min_hops = r->hop_count;
    }

    // Also check other routes flagged as is_sink
    for (int i=0; i<DSDV_ROUTE_TABLE_SIZE; i++) {
        if (g_dsdv_routes[i].dest != 0 && g_dsdv_routes[i].is_sink) {
             if (neighbor_mgr_is_valid(g_dsdv_routes[i].next_hop)) {
                 if (g_dsdv_routes[i].hop_count < min_hops) {
                     min_hops = g_dsdv_routes[i].hop_count;
                 }
             }
        }
    }

    g_dsdv_my_gradient = min_hops;
}

bool dsdv_router_is_duplicate(uint16_t src, uint32_t seq)
{
    for (int i = 0; i < DUP_CACHE_SIZE; i++) {
        if (g_dup_cache[i].src == src && g_dup_cache[i].seq == seq) {
            return true;
        }
    }
    // Add to cache
    g_dup_cache[g_dup_idx].src = src;
    g_dup_cache[g_dup_idx].seq = seq;
    g_dup_idx = (g_dup_idx + 1) % DUP_CACHE_SIZE;
    return false;
}

uint32_t dsdv_router_get_seq(void) { return g_my_seq_num; }
void dsdv_router_inc_seq(void) { g_my_seq_num++; }
```

## src/model_handler.c
```c
/* src/model_handler.c */
#include "model_handler.h"
#include "chat_cli.h"
#include "dsdv_router.h"
#include "neighbor_mgr.h"
#include <zephyr/shell/shell.h>
#include <dk_buttons_and_leds.h>
#include <zephyr/logging/log.h>
#include <zephyr/bluetooth/hci.h>
#include <stdlib.h> 

/* FIX 1: Thêm header cho Config và Health Server */
#include <zephyr/bluetooth/mesh/cfg_srv.h>
#include <zephyr/bluetooth/mesh/health_srv.h>

LOG_MODULE_DECLARE(chat_cli);

#ifndef BT_MESH_CID_NORDIC
#define BT_MESH_CID_NORDIC 0x0059 
#endif

/* FIX 2: Tự định nghĩa Model ID (Sử dụng ID giả lập cho SIG Model) */
#define BT_MESH_MODEL_ID_VENDOR_EXAMPLE  0x1234

static struct bt_mesh_chat_cli chat;

/* FIX 3: Khai báo các struct cần thiết cho Health Server */
static struct bt_mesh_health_srv health_srv = {};
BT_MESH_HEALTH_PUB_DEFINE(health_pub, 0);

/* Định nghĩa mảng Models */
static struct bt_mesh_model root_models[] = {
    BT_MESH_MODEL_CFG_SRV,
    
    /* FIX 4: Truyền tham số cho macro Health Server */
    BT_MESH_MODEL_HEALTH_SRV(&health_srv, &health_pub),
    
    BT_MESH_MODEL_CB(BT_MESH_MODEL_ID_VENDOR_EXAMPLE, 
                     _bt_mesh_chat_cli_op, 
                     &chat.pub, 
                     &chat, 
                     &_bt_mesh_chat_cli_cb)
};

/* Định nghĩa Elements thủ công */
static struct bt_mesh_elem elements[] = {
    {
        .loc = 0,
        .model_count = ARRAY_SIZE(root_models),
        .models = root_models,
        .vnd_model_count = 0,
        .vnd_models = NULL,
    }
};

static const struct bt_mesh_comp comp = {
    .cid = BT_MESH_CID_NORDIC,
    .elem = elements,
    .elem_count = ARRAY_SIZE(elements),
};

/* --- LED Logic --- */
static struct k_work_delayable blink_work;
static int blink_counter = 0;

static void blink_timeout(struct k_work *work)
{
    if (blink_counter > 0) {
        dk_set_led(DK_LED1, blink_counter % 2);
        blink_counter--;
        k_work_reschedule(&blink_work, K_MSEC(200));
    } else {
        dk_set_led_off(DK_LED1);
    }
}

void mesh_led_blink(int count)
{
    blink_counter = count * 2;
    k_work_reschedule(&blink_work, K_NO_WAIT);
}

/* --- Shell Commands --- */

static int cmd_show_routes(const struct shell *shell, size_t argc, char *argv[])
{
    shell_print(shell, "Dest\tNext\tHops\tSeq\tGrad: %d", g_dsdv_my_gradient);
    for (int i = 0; i < DSDV_ROUTE_TABLE_SIZE; i++) {
        if (g_dsdv_routes[i].dest != 0) {
            shell_print(shell, "0x%04x\t0x%04x\t%d\t%d",
                        g_dsdv_routes[i].dest,
                        g_dsdv_routes[i].next_hop,
                        g_dsdv_routes[i].hop_count,
                        g_dsdv_routes[i].seq_num);
        }
    }
    return 0;
}

static int cmd_show_neighbors(const struct shell *shell, size_t argc, char *argv[])
{
    uint16_t addrs[MAX_NEIGHBORS];
    int8_t rssi[MAX_NEIGHBORS];
    int count = neighbor_mgr_get_all(addrs, rssi, MAX_NEIGHBORS);

    shell_print(shell, "Neighbors (%d):", count);
    for (int i = 0; i < count; i++) {
        shell_print(shell, " - Addr: 0x%04x, RSSI: %d", addrs[i], rssi[i]);
    }
    return 0;
}

static int cmd_send_data(const struct shell *shell, size_t argc, char *argv[])
{
    if (argc < 2) {
        shell_error(shell, "Usage: send <val>");
        return -1;
    }
    uint16_t val = (uint16_t)atoi(argv[1]);
    int err = bt_mesh_chat_cli_data_send(&chat, val);
    if (err) {
        shell_error(shell, "Send failed: %d", err);
    } else {
        shell_print(shell, "Sent data: %d", val);
    }
    return 0;
}

SHELL_STATIC_SUBCMD_SET_CREATE(chat_cmds,
    SHELL_CMD(routes, NULL, "Show Routes", cmd_show_routes),
    SHELL_CMD(neighbors, NULL, "Show Neighbors", cmd_show_neighbors),
    SHELL_CMD(send, NULL, "Send Data <val>", cmd_send_data),
    SHELL_SUBCMD_SET_END
);

SHELL_CMD_REGISTER(chat, &chat_cmds, "DSDV Chat", NULL);

/* --- Init --- */

static void button_handler(uint32_t button_state, uint32_t has_changed)
{
    if (has_changed & button_state & DK_BTN1_MSK) {
        static uint16_t btn_cnt = 0;
        bt_mesh_chat_cli_data_send(&chat, ++btn_cnt);
    }
}

const struct bt_mesh_comp *model_handler_init(void)
{
    dk_buttons_init(button_handler);
    k_work_init_delayable(&blink_work, blink_timeout);
    return &comp;
}
```

## src/neighbor_mgr.c
```c
#include "neighbor_mgr.h"
#include <zephyr/kernel.h>
#include <string.h>

struct neighbor_entry {
    uint16_t addr;
    int8_t rssi;
    uint32_t last_seen;
};

static struct neighbor_entry neighbors[MAX_NEIGHBORS];

void neighbor_mgr_init(void)
{
    memset(neighbors, 0, sizeof(neighbors));
}

void neighbor_mgr_update(uint16_t addr, int8_t rssi)
{
    uint32_t now = k_uptime_get_32();
    int oldest_idx = 0;
    uint32_t oldest_time = 0xFFFFFFFF;

    // 1. Try to find existing neighbor
    for (int i = 0; i < MAX_NEIGHBORS; i++) {
        if (neighbors[i].addr == addr) {
            neighbors[i].rssi = rssi;
            neighbors[i].last_seen = now;
            return;
        }
        
        // Track empty slot or oldest slot
        if (neighbors[i].addr == 0) {
            oldest_idx = i;
            oldest_time = 0; // Priority to fill empty
        } else if (neighbors[i].last_seen < oldest_time && oldest_time != 0) {
            oldest_time = neighbors[i].last_seen;
            oldest_idx = i;
        }
    }

    // 2. Add new or replace oldest
    neighbors[oldest_idx].addr = addr;
    neighbors[oldest_idx].rssi = rssi;
    neighbors[oldest_idx].last_seen = now;
}

bool neighbor_mgr_is_valid(uint16_t addr)
{
    uint32_t now = k_uptime_get_32();
    for (int i = 0; i < MAX_NEIGHBORS; i++) {
        if (neighbors[i].addr == addr) {
            return (now - neighbors[i].last_seen) < DSDV_NEIGHBOR_TIMEOUT_MS;
        }
    }
    return false;
}

int neighbor_mgr_get_all(uint16_t *addrs, int8_t *rssi, int max_count)
{
    int count = 0;
    uint32_t now = k_uptime_get_32();

    for (int i = 0; i < MAX_NEIGHBORS && count < max_count; i++) {
        if (neighbors[i].addr != 0 && (now - neighbors[i].last_seen) < DSDV_NEIGHBOR_TIMEOUT_MS) {
            addrs[count] = neighbors[i].addr;
            if (rssi) rssi[count] = neighbors[i].rssi;
            count++;
        }
    }
    return count;
}
```
